## main/Kconfig.projbuild
```kconfig
menu "Eheat Configuration"

    config WIFI_CONNECTION_MAXIMUM_RETRY
        int "WiFi connection maximum retry"
        range 0 255
        default 2
        help
            WiFi connection maximum retry, from 0 to 255.
    config MQTT_CLIENT_IDENTIFIER
        string "The MQTT client identifier used in this code"
        default "envi-5ac245"
        help
            The MQTT client identifier used in this. Each client identifier must be unique.
            so edit as required to ensure that no two clients connecting to the same broker use the same client identifier.
    config MQTT_BROKER_ENDPOINT
        string "Endpoint of the MQTT broker to connect to"
        default "test.mosquitto.org"
        help
            This can be run with any MQTT broker, that supports server authentication.

    config MQTT_BROKER_PORT
        int "Port of the MQTT broker use"
        default 8883
        help
            In general, port 8883 is for secured MQTT connections.
            Port 443 requires use of the ALPN TLS extension with the ALPN protocol name.
            When using port 8883, ALPN is not required.

    config HARDWARE_PLATFORM_NAME
        string "The hardware platform"
        default "ESP32"
        help
            The name of the hardware platform the application is running on.

    config MQTT_NETWORK_BUFFER_SIZE
        int "Size of the network buffer for MQTT packets"
        range 1024 4096
        default 4096
        help
            Size of the network buffer for MQTT packets.
    
    choice EXAMPLE_CHOOSE_PKI_ACCESS_METHOD
        prompt "Choose PKI credentials access method"
        default EXAMPLE_USE_PLAIN_FLASH_STORAGE
        help
            ESP devices support multiple ways to secure store the PKI credentials.
            Currently Secure Element (ATECC608A) and DS peripheral are supported.
            The default behaviour is to access the PKI credentials which are embedded in the binary.
            Consult the ESP-TLS documentation in ESP-IDF Programming guide for more details.

        config EXAMPLE_USE_SECURE_ELEMENT
        bool "Use secure element (ATECC608A)"
        depends on IDF_TARGET_ESP32 && ESP_TLS_USING_MBEDTLS
        # To confirm that we are satisfying the dependancies of secure element
        select ESP_TLS_USE_SECURE_ELEMENT
        select CORE_HTTP_USE_SECURE_ELEMENT
        select CORE_MQTT_USE_SECURE_ELEMENT
        help
            Enable the use of secure element for the code.
            The esp-cryptoauthlib component is required for enabling
            this option.

        config EXAMPLE_USE_DS_PERIPHERAL
        bool "Use DS peripheral"
        depends on ESP_TLS_USING_MBEDTLS && SOC_DIG_SIGN_SUPPORTED
        # To confirm that we are satisfying the dependancies of ds peripheral
        select ESP_TLS_USE_DS_PERIPHERAL
        select CORE_HTTP_USE_DS_PERIPHERAL
        select CORE_MQTT_USE_DS_PERIPHERALEXAMPLE_USE_ESP_SECURE_CERT_MGR
        help
            Enable the use of DS peripheral for the code.
            The DS peripheral on the device must be provisioned first to use this option.

        config EXAMPLE_USE_PLAIN_FLASH_STORAGE
        bool "Use flash storage (default)"
        help
            This option expects the Private key and Device certificate to be embedded in the binary.
            This is the default behaviour.
    endchoice
endmenu
```

## sdkconfig.defaults
```kconfig
# Override some defaults so BT stack is enabled
# in this example

#
# Partition Table
# (It's possible to fit Blufi in 1MB app partition size with some other optimizations, but
# default config is close to 1MB.)
CONFIG_PARTITION_TABLE_SINGLE_APP_LARGE=y

#
# BT config
#
CONFIG_BT_ENABLED=y
CONFIG_BT_GATTC_ENABLE=n
CONFIG_BT_BLE_SMP_ENABLE=n
CONFIG_BT_BLE_BLUFI_ENABLE=y
CONFIG_MBEDTLS_HARDWARE_MPI=n
CONFIG_MBEDTLS_DHM_C=y
#
#OLED
#
CONFIG_SCL_GPIO=17
CONFIG_SDA_GPIO=16
CONFIG_RESET_GPIO=15
#
CONFIG_IDF_TARGET="esp32"
CONFIG_BT_ENABLED=y
# CONFIG_BT_BLE_50_FEATURES_SUPPORTED is not set
CONFIG_BT_BLE_42_FEATURES_SUPPORTED=y
```
